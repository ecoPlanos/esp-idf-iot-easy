## components/amphenol_ge_17xx/Kconfig
```kconfig
menu "Amphenol GE-17XX"

config AMPH_GE17XX_DEFAULT_ATT
    int "Default ADC attenuation"
    default 0
    range 0 3
    help
        Initial attenuation value. 0 - 0dB, 1 - 2.5dB, 2 - 6dB, 3 - 11dB.

config AMPH_GE17XX_DEFAULT_PERIOD_MS
    int "Sensor default period (ms)"
    default 30000
    range 0 4294967295
    help
        Default data acquisition period in milliseconds.

config AMPH_GE17XX_DEFAULT_SAMP_FILTER
    int "Sensor default sample filter"
    default 1
    range 0 2000
    help
        Default data filtering in sample number.

endmenu
```

## components/analog_sen/Kconfig
```kconfig
menu "Analog Sensors"

config ANALOG_SEN_USE_DATA_STORAGE
    bool "Sensor data storage"
    default false
    help
        Let sensor data be stored.

config ANALOG_SEN_USE_CONF_STORAGE
    bool "Sensor configurations storage"
    default false
    help
        Let sensor data be stored and updated.

config ANALOG_SEN_DEFAULT_ATT
    int "Default ADC attenuation"
    default 0
    range 0 3
    help
        Initial attenuation value. 0 - 0dB, 1 - 2.5dB, 2 - 6dB, 3 - 11dB.

config ANALOG_DEFAULT_PERIOD_MS
    int "Sensor default period (ms)"
    default 15000
    range 0 4294967295
    help
        Default data acquisition period in milliseconds.
        
endmenu
```

## components/bme680/Kconfig
```kconfig
menu "BME680"
config BME680_USE_DATA_STORAGE
    bool "Sensor data storage"
    default false
    help
        Let sensor data be stored.

config BME680_USE_CONF_STORAGE
    bool "Sensor configurations storage"
    default false
    help
        Let sensor data be stored and updated.

config BME680_DEFAULT_PERIOD_MS
    int "Sensor default period (ms)"
    default 60000
    range 0 4294967295
    help
        Default data acquisition period in milliseconds.
endmenu
```

## components/circular_buffer/Kconfig
```kconfig
menu "Circular Data buffer"
    choice CIRC_BUFF_DATA_TYPE
        prompt "Circular buffer data type"
        default CIRC_BUFF_SENSOR_T
        help
            Choose datatype for the circular buffer component.

        config CIRC_BUFF_U8_T
            bool "uint8_t"
        config CIRC_BUFF_8_T
            bool "int8_t"
        config CIRC_BUFF_U16_T
            bool "uint16_t"
        config CIRC_BUFF_16_T
            bool "int16_t"
        config CIRC_BUFF_U32_T
            bool "uint32_t"
        config CIRC_BUFF_32_T
            bool "int32_t"
        config CIRC_BUFF_U64_T
            bool "uint64_t"
        config CIRC_BUFF_64_T
            bool "int64_t"
        config CIRC_BUFF_FLOAT_T
            bool "float"
        config CIRC_BUFF_S_T
            bool "String"
        config CIRC_BUFF_V_T
            bool "Void"
        config CIRC_BUFF_SENSOR_T
            bool "Sensor"
    endchoice
    config CIRC_BUFF_S_STATIC_SIZE
        depends on CIRC_BUFF_S_T
        int "Max string length"
        range 1 255
endmenu
```

## components/modern_wind/Kconfig
```kconfig
menu "Wind sensor"

config MODERN_WIND_DEFAULT_ATT
    int "Default ADC attenuation"
    default 0
    range 0 3
    help
        Initial attenuation value. 0 - 0dB, 1 - 2.5dB, 2 - 6dB, 3 - 11dB.

config MODERN_WIND_DEFAULT_PERIOD_MS
    int "Sensor default period (ms)"
    default 30000
    range 0 4294967295
    help
        Default data acquisition period in milliseconds.

config MODERN_WIND_DEFAULT_SAMP_FILTER
    int "Sensor default sample filter"
    default 1
    range 0 2000
    help
        Default data filtering in sample number.

config MODERN_WIND_USE_HW_CTRL
    bool "Sensor default period (ms)"
    default n
    help
        Allow sensor to be controlled by GPIO

endmenu
```

## components/passive_components/Kconfig
```kconfig
menu "Passive Components"

config PASSIVE_COMPONENTS_MAX_REF_NAME_LEN
    int "Maximum component reference name length."
    default 6
    range 1 254

endmenu
```

## components/pms1003/Kconfig
```kconfig
menu "PMS1003"
config PMS1003_AFTER_AWAKE_DELAY_MS
    int "Delay after awake"
    default 30000
    range 0 4294967295
    help
        Delay after sleep before get measurement in milliseconds. If zero, delay is disabled.

config PMS1003_DEFAULT_PERIOD_MS
    int "Sensor default period (ms)"
    default 60000
    range 0 4294967295
    help
        Default data acquisition period in milliseconds.

config PMS1003_USE_HW_CTRL
    bool "Use hardware controll signals"
    default false
    help
        If set, sensor will reset, sleep, awake using the sensor pins SET and RST.
        If not set, sleep and reset operations are done with serial commands.
endmenu
```

## components/press_sen/Kconfig
```kconfig
menu "Wind sensor"

config PRESS_SEN_DEFAULT_ATT
    int "Default ADC attenuation"
    default 0
    range 0 3
    help
        Initial attenuation value. 0 - 0dB, 1 - 2.5dB, 2 - 6dB, 3 - 11dB.

config PRESS_SEN_DEFAULT_PERIOD_MS
    int "Sensor default period (ms)"
    default 30000
    range 0 4294967295
    help
        Default data acquisition period in milliseconds.

config PRESS_SEN_DEFAULT_SAMP_FILTER
    int "Sensor default sample filter"
    default 1
    range 0 2000
    help
        Default data filtering in sample number.

config PRESS_SEN_USE_HW_CTRL
    bool "Sensor default period (ms)"
    default n
    help
        Allow sensor to be controlled by GPIO

endmenu
```

## components/seeed_yf/Kconfig
```kconfig
menu "Seeed YF-Bx"

config SEEED_YF_DEFAULT_PERIOD_MS
    int "Sensor default period (ms)"
    default 30000
    range 0 4294967295
    help
        Default data acquisition period in milliseconds.

endmenu
```

## components/sfa30/Kconfig
```kconfig
menu "SFA30"

config SFA30_USE_DATA_STORAGE
    bool "Sensor data storage"
    default false
    help
        Let sensor data be stored.

config SFA30_USE_CONF_STORAGE
    bool "Sensor configurations storage"
    default false
    help
        Let sensor data be stored and updated.

config SFA30_DEFAULT_PERIOD_MS
    int "Sensor default period (ms)"
    default 60000
    range 0 4294967295
    help
        Default data acquisition period in milliseconds.

config SFA30_DEFAULT_SAMP_FILTER
    int "Sensor default sample filter"
    default 1
    range 0 2000
    help
        Default data filtering in sample number.

endmenu
```

## components/sht85/Kconfig
```kconfig
menu "SHT85"

config SHT85_USE_DATA_STORAGE
    bool "Sensor data storage"
    default false
    help
        Let sensor data be stored.

config SHT85_USE_CONF_STORAGE
    bool "Sensor configurations storage"
    default false
    help
        Let sensor data be stored and updated.

config SHT85_DEFAULT_PERIOD_MS
    int "Sensor default period (ms)"
    default 60000
    range 0 4294967295
    help
        Default data acquisition period in milliseconds.

config SHT85_DEFAULT_SAMP_FILTER
    int "Sensor default sample filter"
    default 1
    range 0 2000
    help
        Default data filtering in sample number.

endmenu
```

## components/sls_bta/Kconfig
```kconfig
menu "SLS_BTA"

config SLS_BTA_DEFAULT_ATT
    int "Default ADC attenuation"
    default 0
    range 0 3
    help
        Initial attenuation value. 0 - 0dB, 1 - 2.5dB, 2 - 6dB, 3 - 11dB.

config SLS_BTA_DEFAULT_PERIOD_MS
    int "Sensor default period (ms)"
    default 30000
    range 0 4294967295
    help
        Default data acquisition period in milliseconds.

config SLS_BTA_DEFAULT_SAMP_FILTER
    int "Sensor default sample filter"
    default 1
    range 0 2000
    help
        Default data filtering in sample number.

endmenu
```

## components/switch_sen/Kconfig
```kconfig
menu "Switch Sensor"
config SWITCH_SEN_USE_DATA_STORAGE
    bool "Sensor data storage."
    default false
    help
        Let sensor data be stored.
config SWITCH_SEN_USE_CONF_STORAGE
    bool "Sensor configurations storage."
    default false
    help
        Let sensor data be stored and updated.
config SWITCH_SEN_ON_MIN_T
    int "Minimum period of detections (us)."
    default 4420420
    range 0 86973087744
    help
        Acts like a filter discarding transitions occurring less than the specified time apart.
config SWITCH_SEN_TRIGGER_DIR
    bool "Trigger direction."
    default true
    help
        Sensor detection is made at rising edge (true) or falling edge (false).
endmenu
```

## components/tsl2591/Kconfig
```kconfig
menu "TSL2591"

config TSL2591_USE_DATA_STORAGE
    bool "Sensor data storage"
    default false
    help
        Let sensor data be stored.

config TSL2591_USE_CONF_STORAGE
    bool "Sensor configurations storage"
    default false
    help
        Let sensor data be stored and updated.

config TSL2591_DEFAULT_PERIOD_MS
    int "Sensor default period (ms)"
    default 60000
    range 0 4294967295
    help
        Default data acquisition period in milliseconds.

config TSL2591_DEFAULT_SAMP_FILTER
    int "Sensor default sample filter"
    default 1
    range 0 2000
    help
        Default data filtering in sample number.

endmenu
```

## components/uartdev/Kconfig
```kconfig
menu "UART Dev"
    config UARTDEV_TIMEOUT
        int "UART transaction timeout, milliseconds"
        default 1000
        range 100 5000

    config UARTDEV_NOLOCK
    	bool "Disable the use of mutexes"
    	default n
    	help
    		Attention! After enabling this option, all UART device
    		drivers will become non-thread safe.
    		Use this option if you need to access your UART devices
    		from interrupt handlers.
    config UARTDEV_RX_BUF_SIZE
        int "UARTDEV_RX_BUF_SIZE"
        default 1024
        range 1 4096
        help
            UART Rx buffer size.
endmenu
```

## components/victron/bmv60x/Kconfig
```kconfig
menu "VICTRON_BMV60X"
config BMV60X_DEFAULT_PERIOD_MS
    int "Sensor default period (ms)"
    default 1000
    range 0 4294967295
    help
        Default data acquisition period in milliseconds.

config BMV60X_DEFAULT_SAMP_FILTER
    int "Sensor default sample filter"
    default 1
    range 0 2000
    help
        Default data filtering in sample number.

config BMV60X_MAX_MODEL_DESC
    int "Maximum device description characters"
    default 6
    range 0 20

config BMV60X_MESSAGE_TIMEOUT
    int "Message wait timeout"
    default 100
    range 1 65000
    help
        Time to wait for the end of a message (baud units)

config BMV60X_ACTIVE_MODE
    bool "Data received with interrupts"
    default true

config BMV60X_ACTIVE_MODE_QUEUE
    int "UART queue size"
    default 0
    range 0 511
endmenu
```

## components/virtual_sensor/Kconfig
```kconfig
menu "VIRTUAL_SENSOR"

config VIRTUAL_SENSOR_USE_DATA_STORAGE
    bool "Sensor data storage"
    default false
    help
        Let sensor data be stored.

config VIRTUAL_SENSOR_USE_CONF_STORAGE
    bool "Sensor configurations storage"
    default false
    help
        Let sensor data be stored and updated.

config VIRTUAL_SENSOR_DEFAULT_PERIOD_MS
    int "Sensor default period (ms)"
    default 10000
    range 0 4294967295
    help
        Default data acquisition period in milliseconds.

endmenu
```

## components/yf_b6/Kconfig
```kconfig
menu "YF-B6"

config YF_B6_DEFAULT_ATT
    int "Default ADC attenuation"
    default 0
    range 0 3
    help
        Initial attenuation value. 0 - 0dB, 1 - 2.5dB, 2 - 6dB, 3 - 11dB.

config YF_B6_DEFAULT_PERIOD_MS
    int "Sensor default period (ms)"
    default 30000
    range 0 4294967295
    help
        Default data acquisition period in milliseconds.

config YF_B6_SUPPLY_VOLTAGE
    int "Sensor supply voltage (mV)"
    default 5000
    range 0 4294967295
    help
        Measured supply voltage

endmenu
```
